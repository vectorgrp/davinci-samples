AUTOSAR XML (schema 00054)
package /ActiveEcuC
  ecuc value collection ActiveEcuC
